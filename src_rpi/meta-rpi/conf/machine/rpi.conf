## src_rpi/meta-rpi/conf/machine/rpi.conf
```bitbake
KMACHINE = "raspberrypi"
#KERNEL_DEVICETREE = "${KMACHINE}-bmc-adam-${MACHINE}.dtb"
#KERNEL_DEVICETREE = "bcm2835-rpi-b.dtb"
#KBUILD_DEFCONFIG = "bcmrpi_defconfig"

UBOOT_MACHINE = "rpi_defconfig"
UBOOT_DEVICETREE = "bcm2835-rpi-b.dts"
SERIAL_CONSOLES = "115200;ttyAMA0"

ARMSTUB ?= "armstub.bin"

require conf/machine/include/tune-arm1176jzf-s.inc
require conf/machine/include/rpi-base.inc
require conf/machine/include/obmc-bsp-common.inc

IMAGE_FSTYPES = "rpi-sdimg"
RPI_USE_U_BOOT = "1"
UBOOT_SIGN_ENABLE = "0"
FLASH_SIZE = "131072"
```

## src_rpi/meta-yyl/conf/machine/yyl.conf
```bitbake
KMACHINE = "raspberrypi"
DEFAULTTUNE = "arm1176jzfshf"

require conf/machine/include/tune-arm1176jzf-s.inc
require conf/machine/include/rpi-base.inc
require conf/machine/include/obmc-bsp-common.inc

ARMSTUB ?= "armstub.bin"

IMAGE_FSTYPES = " squashfs"

UBOOT_MACHINE = "rpi_defconfig"
UBOOT_DEVICETREE = "bcm2835-rpi-b.dts"
SERIAL_CONSOLES = "115200;ttyAMA0"

#KBUILD_DEFCONFIG = "bcmrpi_defconfig"
KBUILD_DEFCONFIG = "bcm2835_defconfig"
```
